## Kconfig
```kconfig
config ZMK_RUNTIME_COMBOS
    bool "Enable runtime combo configuration"

if ZMK_RUNTIME_COMBOS

config ZMK_RUNTIME_COMBOS_MAX_COUNT
    int "Maximum number of runtime combos"
    # Upper bound is set by proto/cormoran/combos/custom.options
    # (GetAllCombosResponse.combos max_count). Raising it past that overflows
    # the response buffer in src/studio/custom_handler.c.
    range 1 16
    default 16

config ZMK_RUNTIME_COMBOS_STUDIO_RPC
    bool "Enable runtime combos custom Studio RPC"
    default y
    depends on ZMK_STUDIO

config ZMK_RUNTIME_COMBOS_ENGINE
    bool "Activate runtime combos on key presses"
    default y
    # zmk_behavior_find_behavior_name_from_local_id() only exists when this is on.
    select ZMK_BEHAVIOR_LOCAL_IDS
    help
      Watch key positions and fire the configured behavior.
      Disabling it removes key-event handling, the two options below, and
      the select of ZMK_BEHAVIOR_LOCAL_IDS. These stay: slot validation (key
      positions must be below ZMK_KEYMAP_LEN; the behavior id must exist when
      ZMK_BEHAVIOR_LOCAL_IDS is enabled by something else), the MAX_COUNT
      range of 1-16, the 10-500 ms clamp of timeout_ms and
      require_prior_idle_ms in the Studio handler (0 keeps its old meaning),
      the scheduler lock around slot updates, rolling a slot back when saving
      it to flash fails, the settings commit hook (its callee becomes an empty
      function), the exported slot table zmk_runtime_combos_slots, the
      per-combo require_prior_idle_ms field (struct, proto field 7, Studio
      handler), and the new settings key with its build-time check that every
      slot name fits the name buffer (combos saved by the pre-engine module
      are not loaded). Studio still receives engine_version 1, with
      engine_enabled set to false. To restore the pre-engine module, pin the
      module back to 119de78.

config ZMK_RUNTIME_COMBOS_MAX_PRESSED
    int "Maximum runtime combos held at the same time"
    range 1 8
    default 4
    depends on ZMK_RUNTIME_COMBOS_ENGINE

config ZMK_RUNTIME_COMBOS_DEFAULT_PRIOR_IDLE_MS
    int "Idle time before a combo may fire, when the app sent no value"
    range 0 1000
    default 100
    depends on ZMK_RUNTIME_COMBOS_ENGINE
    help
      A combo whose keys sit under normal typing would fire on a fast roll.
      This is the window after any key tap in which combos stay disabled.
      Applies only to combos stored with require_prior_idle_ms == 0, which is
      what an app that does not know the field yet sends.

endif
```
